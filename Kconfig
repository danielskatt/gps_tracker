## Kconfig
```kconfig
# GPS Module

mainmenu "GPS module"

rsource "src/Kconfig"
rsource "drivers/Kconfig"

########################################################################
# GNSS (Global Navigation Satellite Systems)
########################################################################

config GNSS
    bool "GNSS enabled"
    default n
    help
        Set this config to enable the GNSS tracker

menu "Zephyr Kernel"
source "Kconfig.zephyr"
endmenu
```

## drivers/gnss/Kconfig
```kconfig
comment "GNSS"

config GNSS_THREAD_SLEEP_MS
    int "Gnss thread sleep [ms]"
    range 1 1000
    default 10
    help
       The time the gnss driver thread sleeps

config LOG_LEVEL_GNSS
    int "Log level [0, 4]"
    default 0
    help
      Set this config entry to log data from GNSS [0, 4]
```

## drivers/sensor/Kconfig
```kconfig
comment "accelerometer driver"

config ACCELEROMETER_DRIVER_LOG_LEVEL
    int "Log level [0, 4]"
    default 0
    help
      Set this config entry to log data from accelerometer driver [0, 4].
```

## src/Kconfig
```kconfig
comment "src"

rsource "gnss_module/Kconfig"
rsource "led_module/Kconfig"

config APPLICATION_MODULE_LOG_LEVEL
    int "Log level [0,4]"
    default 0
    help
        Set this config entry to log data from application module
```

## src/events/Kconfig
```kconfig
#
# Copyright (c) 2021 Nordic Semiconductor
#
# SPDX-License-Identifier: LicenseRef-Nordic-5-Clause
#

menuconfig EVENTS
	bool "Event options"
	default y

if EVENTS

config APP_EVENTS_LOG
	bool "Enable logging for application module events"
	default y

config GNSS_EVENTS_LOG
	bool "Enable logging for GNSS module events"
	default y

endif # EVENTS
```

## src/gnss_module/Kconfig
```kconfig
comment "gnss module"

config GNSS_MODULE_LOG_LEVEL
    int "Log level [0, 4]"
    default 4
    help
      Set this config entry to log data from gnss module [0, 4].

config GNSS_MODULE_THREAD_SLEEP
    int "Time the thread sleeps [ms]"
    default 10
    help
      Set this config entry to set how long the thread will sleep.


module = GNSS_MODULE
module-str = GNSS module
```

## src/led_module/Kconfig
```kconfig
comment "led module"

config LED_MODULE_THREAD_SLEEP_MS
    int "LED module thread sleep [ms]"
    range 1 1000
    default 10
    help
        The time the led module thread sleeps
```

## src/movement/Kconfig
```kconfig
comment "movement"

config MOVEMENT_LOG_LEVEL
    int "Log level [0, 4]"
    default 0
    help
      Set this config entry to log data from movement module [0, 4].

config MOVEMENT_THREAD_SLEEP
    int "Time the thread sleeps [ms]"
    default 100
    help
      Set this config entry to set how long the thread will sleep.
```

## src/positioning/Kconfig
```kconfig
comment "positioning"

config POSITIONING_LOG_LEVEL
    int "Log level [0, 4]"
    default 4
    help
      Set this config entry to log data from gnss module [0, 4].

config POSITIONING_THREAD_SLEEP
    int "Time the thread sleeps [ms]"
    default 10
    help
      Set this config entry to set how long the thread will sleep.


module = GNSS_MODULE
module-str = GNSS module
```

## src/sms/Kconfig
```kconfig
comment "sms"

config SMS_LOG_LEVEL
    int "Log level [0, 4]"
    default 4
    help
      Set this config entry to log data from gnss module [0, 4].

config SMS_THREAD_SLEEP
    int "Time the thread sleeps [ms]"
    default 10
    help
      Set this config entry to set how long the thread will sleep.

config SMS_SEND_PHONE_NUMBER
	string "Phone number, including country code, where the SMS message is sent"
	default ""

module = SMS_MODULE
module-str = SMS module
```
